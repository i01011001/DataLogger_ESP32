## components/wifi/kconfig.projbuild
```kconfig
menu "Wifi connect"
	config WIFI_SSID
		string "Wifi SSID"
		default "podamibe"
	
	config WIFI_PASSWD
		string "Wifi Password"
		default "Chobhar570)))"
endmenu 
```

## main/Kconfig.projbuild
```kconfig
menu "Data Logger Configuration"

		
	orsource ../components/wifi/kconfig.projbuild
endmenu
```
